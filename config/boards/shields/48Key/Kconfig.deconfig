## config/boards/shields/48Key/Kconfig.deconfig
```kconfig
if SHIELD_48KEY
            
 config ZMK_KEYBOARD_NAME
     default "48Key"

endif
```

## config/boards/shields/48Key/Kconfig.defconfig
```kconfig
if SHIELD_48KEY
            
 config ZMK_KEYBOARD_NAME
     default "48Key"
 CONFIG_ZMK_STUDIO=y
endif
```
